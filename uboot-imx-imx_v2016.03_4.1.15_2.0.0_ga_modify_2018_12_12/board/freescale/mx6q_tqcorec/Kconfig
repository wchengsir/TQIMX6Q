## uboot-imx-imx_v2016.03_4.1.15_2.0.0_ga_modify_2018_12_12/board/freescale/mx6q_tqcorec/Kconfig
```kconfig
if TARGET_MX6Q_TQCOREC

	config SYS_BOARD
	        default "mx6q_tqcorec"

	config SYS_VENDOR
	        default "freescale"

	config SYS_CONFIG_NAME
	        default "mx6q_tqcorec"

endif
```

## uboot-imx-imx_v2016.03_4.1.15_2.0.0_ga_modify_2018_12_12/configs/mx6q_tqcorec_defconfig
```kconfig
CONFIG_ARM=y
CONFIG_ARCH_MX6=y
CONFIG_TARGET_MX6Q_TQCOREC=y
CONFIG_SYS_EXTRA_OPTIONS="IMX_CONFIG=board/freescale/mx6q_tqcorec/mx6q_4x_K4B4G1646B.cfg,MX6Q,SYS_USE_SPINOR"
CONFIG_CMD_GPIO=y
```
